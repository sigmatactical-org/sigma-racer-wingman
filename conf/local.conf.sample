## conf/local.conf.sample
```bitbake
#@TYPE: Machine
#@NAME: Sigma Racer Wingman i.MX 8M Plus
#@DESCRIPTION: Sigma motorcycle instrument cluster — i.MX 8M Plus reference

MACHINE ??= "sigma-racer-wingman-imx8mp"
DISTRO ??= "sigma-racer-wingman"

# Source sibling Rust repos (default: symlinks under sigma-racer-wingman/)
SIGMA_INSTRUMENTATION_SRC ??= "${TOPDIR}/../../sigma-instrumentation"
SIGMA_RACER_CLUSTER_SRC ??= "${TOPDIR}/../../sigma-racer/cluster"
SIGMA_VSS_MAP_SRC ??= "${TOPDIR}/../../vss-map"
SIGMA_RACER_VEHICLE_SRC ??= "${TOPDIR}/../../sigma-racer/vehicle"

#
# Package format (also set in conf/distro/sigma-racer-wingman.conf)
#
PACKAGE_CLASSES ?= "package_deb"

#
# Parallel build
#
BB_NUMBER_THREADS ?= "${@oe.utils.cpu_count()}"
PARALLEL_MAKE ?= "-j ${@oe.utils.cpu_count()}"

#
# Disk space
#
DL_DIR ?= "${TOPDIR}/../downloads"
SSTATE_DIR ?= "${TOPDIR}/../sstate-cache"

#
# Production features — uncomment for release images
#
# DISTRO_FEATURES:append = " rauc read-only-rootfs tpm2"
# EXTRA_IMAGE_FEATURES += " read-only-rootfs"

#
# Accept NXP EULA for i.MX BSP components (required for meta-imx)
#
# EULA accepts must be set per meta-imx documentation:
# ACCEPT_FSL_EULA = "1"

#
# RAUC signing (development keys under keys/rauc/, gitignored; CI overrides
# via RAUC_KEY_FILE/RAUC_CERT_FILE env → local.conf in bitbake-release.sh)
#
RAUC_KEY_FILE ?= "${TOPDIR}/../keys/rauc/development-key.pem"
RAUC_CERT_FILE ?= "${TOPDIR}/../keys/rauc/development-cert.pem"

#
# SDK for Rust cross-development
#
# TOOLCHAIN_TARGET_TASK:append = " packagegroup-rust-cross-canadian-${MACHINE}"
```

## meta-co-pilot/conf/distro/co-pilot.conf
```bitbake
require conf/distro/poky.conf
require conf/distro/include/co-pilot-wayland.inc
require conf/distro/include/co-pilot-security.inc

DISTRO = "co-pilot"
DISTRO_NAME = "Sigma Co-Pilot Instrument Cluster"
DISTRO_VERSION = "1.0"
DISTRO_CODENAME = "cluster"

MAINTAINER = "Sigma Embedded <embedded@sigma.local>"

TARGET_VENDOR = "-sigma"

# systemd everywhere
INIT_MANAGER = "systemd"
VIRTUAL-RUNTIME_init_manager = "systemd"
VIRTUAL-RUNTIME_initscripts = "systemd-compat-units"
DISTRO_FEATURES:append = " systemd usrmerge"

# Coredump support (coredumpctl ships in the main systemd package)
PACKAGECONFIG:append:pn-systemd = " coredump"

# Graphics & connectivity baseline
DISTRO_FEATURES:append = " wayland opengl egl gles2 vulkan"
DISTRO_FEATURES:append = " bluetooth wifi nfc pam polkit"
DISTRO_FEATURES:append = " can socketcan"
DISTRO_FEATURES:remove = " x11"

# Production-oriented features (enable in local.conf for target images)
# DISTRO_FEATURES:append = " rauc read-only-rootfs tpm2"

# Prefer NXP BSP kernel and GPU stack (hardware targets only)
PREFERRED_PROVIDER_virtual/kernel = "linux-imx"
PREFERRED_PROVIDER_virtual/libgl = "imx-gpu-viv"
PREFERRED_PROVIDER_virtual/egl = "imx-gpu-viv"
PREFERRED_PROVIDER_virtual/libgles2 = "imx-gpu-viv"

# Virtual QEMU target — upstream kernel + Mesa (see machine/co-pilot-qemu.conf)
PREFERRED_PROVIDER_virtual/kernel:virt = "linux-yocto"
PREFERRED_PROVIDER_virtual/libgl:virt = "mesa"
PREFERRED_PROVIDER_virtual/egl:virt = "mesa"
PREFERRED_PROVIDER_virtual/libgles2:virt = "mesa"
PREFERRED_PROVIDER_virtual/libgbm:virt = "mesa"

# Wayland compositor
PREFERRED_PROVIDER_virtual/weston = "weston"

# Rust toolchain (meta-rust) — instrumentation uses edition 2024 (needs 1.85+)
require conf/distro/include/rust_versions.inc
RUST_VERSION = "1.86.0"
# Poky's x86_64 layout is pre-Rust 1.80; rustc 1.86 rejects it when cross-compiling.
DATA_LAYOUT[x86_64] = "e-m:e-p270:32:32-p271:32:32-p272:64:64-i64:64-i128:128-f80:128-n8:16:32:64-S128"

# Image defaults
IMAGE_FSTYPES ?= "wic.gz wic.bmap ext4.gz"
WKS_FILE ?= "co-pilot-ab.wks.in"

# Read-only root with overlay for /etc and /var when enabled
OVERLAYFS_ETC_USE_ORIG_INIT_FILE = "1"

# OTA / RAUC slot naming
RAUC_SLOT_ROOTFS_A = "rootfs_a"
RAUC_SLOT_ROOTFS_B = "rootfs_b"

# Instrument cluster runs as dedicated user
CO_PILOT_USER = "cluster"
CO_PILOT_GROUP = "cluster"

# Sole UI application (instrumentation / sigma-dash)
CO_PILOT_CLUSTER_APP = "sigma-dash"
CO_PILOT_UI_PACKAGE = "instrumentation"

INHERIT += "uninative"
```

## meta-sigma-racer-wingman/conf/distro/sigma-racer-wingman.conf
```bitbake
require conf/distro/poky.conf
require conf/distro/include/sigma-racer-wingman-wayland.inc
require conf/distro/include/sigma-racer-wingman-security.inc

DISTRO = "sigma-racer-wingman"
DISTRO_NAME = "Sigma Racer Wingman Instrument Cluster"
DISTRO_VERSION = "1.1"
DISTRO_CODENAME = "cluster"

MAINTAINER = "Sigma Embedded <embedded@sigma.local>"

TARGET_VENDOR = "-sigma"

# Debian packages on target (not RPM/IPK)
PACKAGE_CLASSES = "package_deb"

# systemd everywhere
INIT_MANAGER = "systemd"
VIRTUAL-RUNTIME_init_manager = "systemd"
VIRTUAL-RUNTIME_initscripts = "systemd-compat-units"
DISTRO_FEATURES:append = " systemd usrmerge"

# Coredump support (coredumpctl ships in the main systemd package)
PACKAGECONFIG:append:pn-systemd = " coredump"

# Graphics & connectivity baseline
DISTRO_FEATURES:append = " wayland opengl egl gles2 vulkan"
DISTRO_FEATURES:append = " bluetooth wifi nfc pam polkit"
DISTRO_FEATURES:append = " can socketcan"
DISTRO_FEATURES:remove = " x11"

# A/B OTA updates (RAUC). read-only-rootfs/tpm2 remain opt-in via local.conf.
DISTRO_FEATURES:append = " rauc"
# DISTRO_FEATURES:append = " read-only-rootfs tpm2"

# Prefer NXP BSP kernel and GPU stack (hardware targets only)
PREFERRED_PROVIDER_virtual/kernel = "linux-imx"
PREFERRED_PROVIDER_virtual/libgl = "imx-gpu-viv"
PREFERRED_PROVIDER_virtual/egl = "imx-gpu-viv"
PREFERRED_PROVIDER_virtual/libgles2 = "imx-gpu-viv"

# Virtual QEMU target — upstream kernel + Mesa (see machine/sigma-racer-wingman-qemu.conf)
PREFERRED_PROVIDER_virtual/kernel:virt = "linux-yocto"
PREFERRED_PROVIDER_virtual/libgl:virt = "mesa"
PREFERRED_PROVIDER_virtual/egl:virt = "mesa"
PREFERRED_PROVIDER_virtual/libgles2:virt = "mesa"
PREFERRED_PROVIDER_virtual/libgbm:virt = "mesa"

# Wayland compositor
PREFERRED_PROVIDER_virtual/weston = "weston"

# Rust toolchain (meta-rust) — instrumentation uses edition 2024; sigma crates pin MSRV 1.97.0
require conf/distro/include/rust_versions.inc
RUST_VERSION = "1.97.0"
# Poky's x86_64 layout is pre-Rust 1.80; rustc 1.86 rejects it when cross-compiling.
DATA_LAYOUT[x86_64] = "e-m:e-p270:32:32-p271:32:32-p272:64:64-i64:64-i128:128-f80:128-n8:16:32:64-S128"

# Image defaults
# ext4 (uncompressed) feeds the RAUC bundle rootfs slot.
IMAGE_FSTYPES ?= "wic.gz wic.bmap ext4 ext4.gz"
WKS_FILE ?= "sigma-racer-wingman-ab.wks.in"
# Default boot partition size for the A/B WIC layout; machines may override.
SIGMA_RACER_WINGMAN_BOOT_PART_SIZE ??= "128M"

# Read-only root with overlay for /etc and /var when enabled
OVERLAYFS_ETC_USE_ORIG_INIT_FILE = "1"

# OTA / RAUC slot naming
RAUC_SLOT_ROOTFS_A = "rootfs_a"
RAUC_SLOT_ROOTFS_B = "rootfs_b"

# Instrument cluster runs as dedicated user
SIGMA_RACER_WINGMAN_USER = "cluster"
SIGMA_RACER_WINGMAN_GROUP = "cluster"
SIGMA_RACER_WINGMAN_VEHICLE_USER = "vehicle"

# Sole UI application
SIGMA_RACER_WINGMAN_CLUSTER_APP = "sigma-racer-cluster"
SIGMA_RACER_WINGMAN_UI_PACKAGE = "sigma-racer-cluster"

INHERIT += "uninative"
```

## meta-sigma-racer-wingman/conf/layer.conf
```bitbake
# We have a conf and classes directory, add to BBPATH
BBPATH .= ":${LAYERDIR}"

# Our pinned Rust/Cargo 1.90.0 recipes (recipes-devtools/{rust,cargo}/) carry
# only the version-specific bits (rust-source/-snapshot .inc) and `require` the
# shared, version-agnostic includes that ship in the vendored meta-rust layer
# (rust-target.inc, cargo.inc, rust-cross.inc, rust-llvm.inc, ...). meta-rust
# only puts its layer root on BBPATH, so add its recipe dirs here to resolve
# those bare requires without editing the vendored layer.
BBPATH .= ":${LAYERDIR}/../../meta-rust/recipes-devtools/rust"
BBPATH .= ":${LAYERDIR}/../../meta-rust/recipes-devtools/cargo"

# We have recipes-* directories, add to BBFILES
BBFILES += "${LAYERDIR}/recipes-*/*/*.bb \
            ${LAYERDIR}/recipes-*/*/*.bbappend"

# i.MX-BSP-only content (e.g. the qemu 8.2.2.imx sched_attr patch). Parsed only
# when the meta-imx BSP layer (fsl-bsp-release) is in the build, so the QEMU-virt
# target — which has no .imx recipes — doesn't choke on orphaned bbappends.
BBFILES_DYNAMIC += " \
    fsl-bsp-release:${LAYERDIR}/dynamic-layers/fsl-bsp-release/recipes-*/*/*.bb \
    fsl-bsp-release:${LAYERDIR}/dynamic-layers/fsl-bsp-release/recipes-*/*/*.bbappend \
"

BBFILE_COLLECTIONS += "sigma-racer-wingman"
BBFILE_PATTERN_sigma-racer-wingman = "^${LAYERDIR}/"
BBFILE_PRIORITY_sigma-racer-wingman = "20"

LAYERDEPENDS_sigma-racer-wingman = "core openembedded-layer"
# meta-imx, meta-freescale, meta-rust, meta-rauc added via bblayers.conf.sample
LAYERSERIES_COMPAT_sigma-racer-wingman = "scarthgap"

# Instrumentation UI — sibling repos under embedded/
SIGMA_RACER_WINGMAN_ROOT ??= "${LAYERDIR}/../.."
SIGMA_INSTRUMENTATION_SRC ??= "${SIGMA_RACER_WINGMAN_ROOT}/sigma-instrumentation"
SIGMA_RACER_CLUSTER_SRC ??= "${SIGMA_RACER_WINGMAN_ROOT}/sigma-racer-cluster"
SIGMA_RACER_VEHICLE_SRC ??= "${SIGMA_RACER_WINGMAN_ROOT}/sigma-racer-vehicle"
SIGMA_RACER_TELEMETRY_SRC ??= "${SIGMA_RACER_WINGMAN_ROOT}/sigma-racer-telemetry"
SIGMA_RACER_SIDEARM_SRC ??= "${SIGMA_RACER_WINGMAN_ROOT}/sigma-racer-sidearm"

LICENSE_PATH += "${LAYERDIR}/licenses"
```
